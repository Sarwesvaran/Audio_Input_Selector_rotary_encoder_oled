#define sw 7
#define ch1 11
#define ch2 10
#define ch3 9
#include <Encoder.h>
#include <EEPROM.h>
#include <Wire.h>
#include <Adafruit_GFX.h>
#include <Adafruit_SSD1306.h>
#include <MsTimer2.h>

#define OLED_RESET -1
Adafruit_SSD1306 display(OLED_RESET);


#define SCREEN_WIDTH 128 // OLED display width, in pixels
#define SCREEN_HEIGHT 64 // OLED display height, in pixels

Encoder myEnc(2, 3);
//   avoid using pins with LEDs attached
int menu = 1, temp, sel, menu_sel, scroll;
int menu_mem = 0, boot = 0;
long oldPosition  = -999, newPosition;


const unsigned char aux_menu [] PROGMEM = {
  0xff, 0xff, 0xff, 0xff, 0xff, 0xff, 0xff, 0xe1, 0x83, 0xff, 0xff, 0xff, 0xff, 0xff, 0xff, 0xff,
  0xff, 0xff, 0xff, 0xff, 0xff, 0xff, 0xff, 0xcc, 0x99, 0xff, 0xff, 0xff, 0xff, 0xff, 0xff, 0xff,
  0xff, 0xff, 0xff, 0xff, 0xff, 0xff, 0xff, 0xdf, 0x9d, 0xff, 0xff, 0xff, 0xff, 0xff, 0xff, 0xff,
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  0xff, 0xff, 0xff, 0xff, 0xff, 0xff, 0xfe, 0x1b, 0xdc, 0x7f, 0xff, 0xff, 0xff, 0xff, 0xff, 0xff
};
// '2b', 128x32px
const unsigned char cd_menu [] PROGMEM = {
  0xff, 0xff, 0xff, 0xff, 0xff, 0xff, 0xfc, 0x1e, 0x7c, 0x3f, 0xff, 0xff, 0xff, 0xff, 0xff, 0xff,
  0xff, 0xff, 0xff, 0xff, 0xff, 0xff, 0xfc, 0xce, 0x7b, 0xbf, 0xff, 0xff, 0xff, 0xff, 0xff, 0xff,
  0xff, 0xff, 0xff, 0xff, 0xff, 0xff, 0xfc, 0xec, 0xbb, 0xff, 0xff, 0xff, 0xff, 0xff, 0xff, 0xff,
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  0xff, 0xff, 0xff, 0xff, 0xff, 0xff, 0xfe, 0xf6, 0x3b, 0xbf, 0xff, 0xff, 0xff, 0xff, 0xff, 0xff
};
// '2c', 128x32px
const unsigned char dac_menu [] PROGMEM = {
  0xff, 0xff, 0xff, 0xff, 0xff, 0xff, 0xff, 0xff, 0xff, 0xff, 0xff, 0xff, 0xff, 0xff, 0xff, 0xff,
  0xff, 0xff, 0xff, 0xff, 0xff, 0xff, 0xfe, 0x79, 0xd9, 0x3f, 0xff, 0xff, 0xff, 0xff, 0xff, 0xff,
  0xff, 0xff, 0xff, 0xff, 0xff, 0xff, 0xfe, 0xb9, 0xdd, 0x7f, 0xff, 0xff, 0xff, 0xff, 0xff, 0xff,
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  0xff, 0xff, 0xff, 0xff, 0xff, 0xff, 0xff, 0xf1, 0xc3, 0xff, 0xff, 0xff, 0xff, 0xff, 0xff, 0xff
};

const unsigned char aux_sym [] PROGMEM = {
  0x00, 0x00, 0x00, 0x00, 0x00, 0x00, 0x00, 0x00, 0x00, 0x00, 0x00, 0x00, 0x00, 0x00, 0x00, 0x00,
  0x7f, 0xff, 0xff, 0xff, 0xff, 0xff, 0xff, 0xff, 0xff, 0xff, 0xff, 0xff, 0xff, 0xff, 0xff, 0xfe,
  0x7f, 0xff, 0xff, 0xff, 0xff, 0xff, 0xff, 0xff, 0xff, 0xff, 0xff, 0xff, 0xff, 0xff, 0xff, 0xfe,
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  0x00, 0x00, 0x00, 0x00, 0x00, 0x00, 0x00, 0x00, 0x00, 0x00, 0x00, 0x00, 0x00, 0x00, 0x00, 0x00
};

const unsigned char cd_sym [] PROGMEM = {
  0x00, 0x00, 0x00, 0x00, 0x00, 0x00, 0x00, 0x00, 0x00, 0x00, 0x00, 0x00, 0x00, 0x00, 0x00, 0x00,
  0x7f, 0xff, 0xff, 0xff, 0xff, 0xff, 0xff, 0xff, 0xff, 0xff, 0xff, 0xff, 0xff, 0xff, 0xff, 0xfe,
  0x7f, 0xff, 0xff, 0xff, 0xff, 0xff, 0xff, 0xff, 0xff, 0xff, 0xff, 0x0e, 0x66, 0xfc, 0xdc, 0xce,
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  0x00, 0x00, 0x00, 0x00, 0x00, 0x00, 0x00, 0x00, 0x00, 0x00, 0x00, 0x00, 0x00, 0x00, 0x00, 0x00
};


const unsigned char dac_sym [] PROGMEM = {
  0x00, 0x00, 0x00, 0x00, 0x00, 0x00, 0x00, 0x00, 0x00, 0x00, 0x00, 0x00, 0x00, 0x00, 0x00, 0x00,
  0x7f, 0xff, 0xff, 0xff, 0xff, 0xff, 0xff, 0xff, 0xff, 0xff, 0xff, 0xff, 0xff, 0xff, 0xff, 0xfe,
  0x7f, 0xff, 0xff, 0xff, 0xff, 0xff, 0xff, 0xff, 0xff, 0xff, 0xff, 0xff, 0xff, 0xff, 0xff, 0xfe,
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  0x00, 0x00, 0x00, 0x00, 0x00, 0x00, 0x00, 0x00, 0x00, 0x00, 0x00, 0x00, 0x00, 0x00, 0x00, 0x00
};


void setup() {
  display.begin(SSD1306_SWITCHCAPVCC, 0x3C);
  display.clearDisplay();
  pinMode(sw, INPUT);
  pinMode(ch1, OUTPUT);
  pinMode(ch2, OUTPUT);
  pinMode(ch3, OUTPUT);
  MsTimer2::set(3, to_Timer); MsTimer2::start();
  digitalWrite(ch1, HIGH); digitalWrite(ch2, HIGH); digitalWrite(ch3, HIGH);
  delay(2000);
  
  if (EEPROM.read(menu_mem) == 1)
  {
    temp = 1;
    digitalWrite(ch1, LOW);
    digitalWrite(ch2, HIGH);
    digitalWrite(ch3, HIGH);
  }
  if (EEPROM.read(menu_mem) == 2)
  {
    temp = 1;
    digitalWrite(ch1, HIGH);
    digitalWrite(ch2, LOW);
    digitalWrite(ch3, HIGH);
  }
  if (EEPROM.read(menu_mem) == 3)
  {
    temp = 1;
    digitalWrite(ch1, HIGH);
    digitalWrite(ch2, HIGH);
    digitalWrite(ch3, LOW);
  }
  // Clear the buffer.
  display.clearDisplay();

}
void loop() {

  // long newPosition = myEnc.read() / 4;

  if (EEPROM.read(menu_mem) == 1 and temp == 1)
  {
    temp = 0;
    display.drawBitmap(0, 0,  aux_sym, 128, 64, BLACK, WHITE);
    display.display();
  }
  if (EEPROM.read(menu_mem) == 2 and temp == 1)
  {
    temp = 0;
    display.drawBitmap(0, 0,  cd_sym, 128, 64, BLACK, WHITE);
    display.display();
  }
  if (EEPROM.read(menu_mem) == 3 and temp == 1)
  {
    temp = 0;
    display.drawBitmap(0, 0,  dac_sym, 128, 64, BLACK, WHITE);
    display.display();
  }

  if ((newPosition != oldPosition)) {
    oldPosition = newPosition;
    menu = menu + newPosition;
    myEnc.write(0); newPosition = 0;
    if (boot == 1)
    {
      myEnc.write(0);
      newPosition = 0;
      digitalWrite(ch1, HIGH); digitalWrite(ch2, HIGH); digitalWrite(ch3, HIGH);
      temp = 0;
      sel = 0;
      if (menu > 3)
        menu = 1;
      if (menu < 1)
        menu = 3;

      //Serial.println(menu);

      if (menu == 1)
      {
        display.drawBitmap(0, 0,  aux_menu, 128, 64, BLACK, WHITE);
      }
      if (menu == 2)
      {
        display.drawBitmap(0, 0,  cd_menu, 128, 64, BLACK, WHITE);
      }
      if (menu == 3)
      {
        display.drawBitmap(0, 0,  dac_menu, 128, 64, BLACK, WHITE);
      }
      display.display();
    }
    boot = 1;
  }
  if (digitalRead(sw) == LOW and sel == 0)
  {
    EEPROM.write(menu_mem, menu);
    sel = 1;

    if (EEPROM.read(menu_mem) == 1 and temp == 0)
    {
      temp = 1;
      digitalWrite(ch1, LOW);
      digitalWrite(ch2, HIGH);
      digitalWrite(ch3, HIGH);
    }
    if (EEPROM.read(menu_mem) == 2 and temp == 0)
    {
      temp = 1;
      digitalWrite(ch1, HIGH);
      digitalWrite(ch2, LOW);
      digitalWrite(ch3, HIGH);
    }
    if (EEPROM.read(menu_mem) == 3 and temp == 0)
    {
      temp = 1;
      digitalWrite(ch1, HIGH);
      digitalWrite(ch2, HIGH);
      digitalWrite(ch3, LOW);
    }
  }
}
void to_Timer() {
  newPosition = myEnc.read() / 4;
}
